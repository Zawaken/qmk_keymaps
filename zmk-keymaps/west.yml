## zmk-keymaps/west.yml
```yaml
manifest:
  remotes:
    - name: cornix-shield
      url-base: https://github.com/hitsmaxft
    - name: petejohanson
      url-base: https://github.com/petejohanson
    - name: zmkfirmware
      url-base: https://github.com/zmkfirmware
  projects:
    - name: zmk
      remote: zmkfirmware
      revision: main
      import: app/west.yml
    - name: blank-slate-zmk-module
      remote: petejohanson
      revision: main
    - name: zmk-shield-cornix
      remote: cornix-shield
      revision: main
  self:
    path: zmk-keymaps
```
